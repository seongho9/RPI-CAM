## yocto/conf/local.conf
```bitbake
# This sets the default machine to be qemux86-64 if no other machine is selected:
MACHINE ??= "raspberrypi5"
DISTRO ?= "poky"

EXTRA_IMAGE_FEATURES ?= "debug-tweaks tools-sdk tools-debug ssh-server-openssh"

IMAGE_INSTALL:append = \
    " dhcpcd x264 \
    gstreamer1.0 gstreamer1.0-plugins-base gstreamer1.0-plugins-good gstreamer1.0-plugins-ugly gstreamer1.0-plugins-bad gstreamer1.0-rtsp-server \
    v4l-utils libcamera libcamera-dev \
    curl openssl libmicrohttpd gdbserver \
    ncnn-dev libeigen-dev openmp jpeg zlib libgomp\
    opencv boost \
    "

TOOLCHAIN_TARGET_TASK:append = " \
    gstreamer1.0-dev gstreamer1.0-plugins-base-dev gstreamer1.0-plugins-good-dev gstreamer1.0-plugins-ugly gstreamer1.0-rtsp-server-dev \
    v4l-utils libcamera-dev opencv \
    curl-dev openssl-dev libmicrohttpd-dev \
    ncnn-dev libeigen-dev \
    "
TOOLCHAIN_HOST_TASK:append = ""

SDK_SYSROOT_RELOCATE:task = "1"

DISTRO_FEATURES:append = " opengl"

RPI_EXTRA_CONFIG = " \
    start_x=1 \
    gpu_mem=128 \
    camera_auto_detect=1 \
    dtoverlay=vc4-kms-v3d \
    max_framebuffers=2 \
    disable_fw_kms_setup=1 \
    otg_mode=1 \
    dtoverlay=dwc2 \
    dr_mode=host \
    dtoverlay=ov5647 \
"
ENABLE_LIBCAMERA = "1"
RASPBERRYPI_CAMERA_V1 = "1"
# overlays/gpio-zshutdown.dtbo
RPI_KERNEL_DEVICETREE_OVERLAYS += "\
    overlays/ov5647.dtbo overlays/at86rf233.dtbo overlays/hifiberry-dacplusadc.dtbo overlays/iqaudio-dac.dtbo overlays/justboom-digi.dtbo overlays/vc4-kms-v3d-pi4.dtbo \
    overlays/justboom-dac.dtbo overlays/vc4-kms-v3d.dtbo overlays/pitft28-resistive.dtbo overlays/rpi-ft5406.dtbo overlays/imx477.dtbo overlays/hifiberry-amp.dtbo \
    overlays/pitft35-resistive.dtbo overlays/imx708.dtbo overlays/gpio-key.dtbo overlays/mcp2515-can1.dtbo overlays/dwc2.dtbo overlays/hifiberry-dacplushd.dtbo \
    overlays/hifiberry-dacplusadcpro.dtbo overlays/vc4-fkms-v3d-pi4.dtbo overlays/overlay_map.dtb overlays/hifiberry-digi-pro.dtbo overlays/gpio-poweroff.dtbo overlays/iqaudio-dacplus.dtbo \
    overlays/justboom-both.dtbo overlays/pitft22.dtbo overlays/hifiberry-dac.dtbo overlays/wm8960-soundcard.dtbo overlays/hifiberry-amp4pro.dtbo overlays/pps-gpio.dtbo \
    overlays/vc4-fkms-v3d.dtbo overlays/i2c-gpio.dtbo overlays/imx219.dtbo overlays/w1-gpio.dtbo overlays/hifiberry-digi.dtbo overlays/hifiberry-dacplusdsp.dtbo \
    overlays/hifiberry-amp3.dtbo overlays/pitft28-capacitive.dtbo overlays/gpio-ir-tx.dtbo overlays/vc4-kms-dsi-7inch.dtbo overlays/hifiberry-amp100.dtbo overlays/rpi-poe.dtbo \
    overlays/disable-wifi.dtbo overlays/mcp2515-can0.dtbo overlays/gpio-ir.dtbo overlays/mcp3008.dtbo overlays/hifiberry-dacplus.dtbo overlays/at86rf233.dtbo overlays/miniuart-bt.dtbo \
    overlays/vc4-kms-v3d-pi5.dtbo overlays/disable-bt.dtbo overlays/w1-gpio-pullup.dtbo overlays/i2c-rtc.dtbo"
    
LICENSE_FLAGS_ACCEPTED += "synaptics-killswitch"
LICENSE_FLAGS_ACCEPTED += "commercial"

USER_CLASSES ?= "buildstats"


VIDEO_CAMERA = "1"

BB_DISKMON_DIRS ??= "\
    STOPTASKS,${TMPDIR},1G,100K \
    STOPTASKS,${DL_DIR},1G,100K \
    STOPTASKS,${SSTATE_DIR},1G,100K \
    STOPTASKS,/tmp,100M,100K \
    HALT,${TMPDIR},100M,1K \
    HALT,${DL_DIR},100M,1K \
    HALT,${SSTATE_DIR},100M,1K \
    HALT,/tmp,10M,1K"

#
# Shared-state files from other locations
#
# As mentioned above, shared state files are prebuilt cache data objects which can be
# used to accelerate build time. This variable can be used to configure the system
# to search other mirror locations for these objects before it builds the data itself.
#
# This can be a filesystem directory, or a remote url such as https or ftp. These
# would contain the sstate-cache results from previous builds (possibly from other
# machines). This variable works like fetcher MIRRORS/PREMIRRORS and points to the
# cache locations to check for the shared objects.
# NOTE: if the mirror uses the same structure as SSTATE_DIR, you need to add PATH
# at the end as shown in the examples below. This will be substituted with the
# correct path within the directory structure.
#SSTATE_MIRRORS ?= "\
#file://.* https://someserver.tld/share/sstate/PATH;downloadfilename=PATH \
#file://.* file:///some/local/dir/sstate/PATH"

#
# Yocto Project SState Mirror
#
# The Yocto Project has prebuilt artefacts available for its releases, you can enable
# use of these by uncommenting some of the following lines. This will mean the build uses
# the network to check for artefacts at the start of builds, which does slow it down
# initially but it will then speed up the builds by not having to build things if they are
# present in the cache. It assumes you can download something faster than you can build it
# which will depend on your network.
# Note: For this to work you also need hash-equivalence passthrough to the matching server
# There is a choice between our sstate server directly and a faster content delivery network
# (CDN) kindly provided by JSDelivr, uncomment one of the SSTATE_MIRRORS lines, not both.
# Using the CDN rather than the yoctoproject.org address is suggested/preferred.
#
#BB_HASHSERVE_UPSTREAM = 'wss://hashserv.yoctoproject.org/ws'
#SSTATE_MIRRORS ?= "file://.* http://cdn.jsdelivr.net/yocto/sstate/all/PATH;downloadfilename=PATH"
#
###SSTATE_MIRRORS ?= "file://.* http://sstate.yoctoproject.org/all/PATH;downloadfilename=PATH"


#
# Qemu configuration
#
# By default native qemu will build with a builtin VNC server where graphical output can be
# seen. The line below enables the SDL UI frontend too.
PACKAGECONFIG:append:pn-qemu-system-native = " sdl"
PACKAGECONFIG:append:pn-gstreamer1.0-plugins-ugly = " x264"
PACKAGECONFIG:append:pn-libcamera = " ipa"

# By default libsdl2-native will be built, if you want to use your host's libSDL instead of 
# the minimal libsdl built by libsdl2-native then uncomment the ASSUME_PROVIDED line below.
#ASSUME_PROVIDED += "libsdl2-native"

# You can also enable the Gtk UI frontend, which takes somewhat longer to build, but adds
# a handy set of menus for controlling the emulator.
#PACKAGECONFIG:append:pn-qemu-system-native = " gtk+"

#
# Hash Equivalence
#
# Enable support for automatically running a local hash equivalence server and
# instruct bitbake to use a hash equivalence aware signature generator. Hash
# equivalence improves reuse of sstate by detecting when a given sstate
# artifact can be reused as equivalent, even if the current task hash doesn't
# match the one that generated the artifact.
#
# A shared hash equivalent server can be set with "<HOSTNAME>:<PORT>" format
#
#BB_HASHSERVE = "auto"
#BB_SIGNATURE_HANDLER = "OEEquivHash"

#
# Memory Resident Bitbake
#
# Bitbake's server component can stay in memory after the UI for the current command
# has completed. This means subsequent commands can run faster since there is no need
# for bitbake to reload cache files and so on. Number is in seconds, after which the
# server will shut down.
#
#BB_SERVER_TIMEOUT = "60"

# CONF_VERSION is increased each time build/conf/ changes incompatibly and is used to
# track the version of this file when it was generated. This can safely be ignored if
# this doesn't mean anything to you.
CONF_VERSION = "2"
```
